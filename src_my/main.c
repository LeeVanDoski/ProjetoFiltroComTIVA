#include "main.h"
#include "LCD.h"

uint32_t adcSamples[3];

void init_hw(){
  SystemClock=SysCtlClockFreqSet((SYSCTL_XTAL_25MHZ |
                               SYSCTL_OSC_MAIN |
                               SYSCTL_USE_PLL |
                               SYSCTL_CFG_VCO_480), 120000000);
	//freq 120MHz

    SysCtlPeripheralEnable(SYSCTL_PERIPH_TIMER0);
    SysCtlPeripheralEnable(SYSCTL_PERIPH_TIMER1);
    SysCtlPeripheralEnable(SYSCTL_PERIPH_GPIOF);
    SysCtlPeripheralEnable(SYSCTL_PERIPH_GPIOK);
    SysCtlPeripheralEnable(SYSCTL_PERIPH_GPIOE);
    SysCtlPeripheralEnable(SYSCTL_PERIPH_GPIOA);
    SysCtlPeripheralEnable(SYSCTL_PERIPH_GPIOC);
    SysCtlPeripheralEnable(SYSCTL_PERIPH_ADC0);
    SysCtlPeripheralEnable(SYSCTL_PERIPH_UART0);
    SysCtlPeripheralEnable(SYSCTL_PERIPH_GPION);
    SysCtlPeripheralEnable(SYSCTL_PERIPH_GPIOL);
    SysCtlPeripheralEnable(SYSCTL_PERIPH_PWM0);
    while(!SysCtlPeripheralReady(SYSCTL_PERIPH_ADC0)||!SysCtlPeripheralReady(SYSCTL_PERIPH_TIMER0)
            ||!SysCtlPeripheralReady(SYSCTL_PERIPH_UART0)||!SysCtlPeripheralReady(SYSCTL_PERIPH_GPIOK)
          ||!SysCtlPeripheralReady(SYSCTL_PERIPH_GPIOE)||!SysCtlPeripheralReady(SYSCTL_PERIPH_GPIOA)
        ||!SysCtlPeripheralReady(SYSCTL_PERIPH_GPION)||!SysCtlPeripheralReady(SYSCTL_PERIPH_GPIOL)
      ||!SysCtlPeripheralReady(SYSCTL_PERIPH_GPIOC)||!SysCtlPeripheralReady(SYSCTL_PERIPH_PWM0)
    ||!SysCtlPeripheralReady(SYSCTL_PERIPH_GPIOF)||!SysCtlPeripheralReady(SYSCTL_PERIPH_TIMER1)){};

    //PF2 de pwm
    GPIOPinConfigure(GPIO_PF2_M0PWM2);
    GPIOPinTypePWM(GPIO_PORTF_BASE,GPIO_PIN_2);
		PWMClockSet(PWM0_BASE, PWM_SYSCLK_DIV_1);
		//120MHz/8
		PWMGenConfigure(PWM0_BASE, PWM_GEN_1, PWM_GEN_MODE_DOWN | PWM_GEN_MODE_NO_SYNC);
		PWMGenPeriodSet(PWM0_BASE, PWM_GEN_1, (SystemClock /200000));//200kHz
    PWMPulseWidthSet(PWM0_BASE, PWM_OUT_2, 600 / 2);
		PWMGenEnable(PWM0_BASE, PWM_GEN_1);
		PWMOutputState(PWM0_BASE, PWM_OUT_2_BIT, true);

    //joystick button
    GPIODirModeSet(GPIO_PORTC_BASE, GPIO_PIN_6, GPIO_DIR_MODE_IN);
    GPIOPadConfigSet(GPIO_PORTC_BASE, GPIO_PIN_6, GPIO_STRENGTH_2MA, GPIO_PIN_TYPE_STD_WPU);
    GPIOIntTypeSet(GPIO_PORTC_BASE, GPIO_PIN_6, GPIO_FALLING_EDGE);
    GPIOIntEnable(GPIO_PORTC_BASE, GPIO_PIN_6);
		IntEnable(INT_GPIOC_TM4C129);

    //botões
    GPIODirModeSet(GPIO_PORTL_BASE, GPIO_PIN_1|GPIO_PIN_2, GPIO_DIR_MODE_IN);
    GPIOPadConfigSet(GPIO_PORTL_BASE, GPIO_PIN_1|GPIO_PIN_2, GPIO_STRENGTH_2MA, GPIO_PIN_TYPE_STD_WPU);
    GPIOIntTypeSet(GPIO_PORTL_BASE, GPIO_PIN_1|GPIO_PIN_2, GPIO_FALLING_EDGE);
    GPIOIntEnable(GPIO_PORTL_BASE, GPIO_PIN_1|GPIO_PIN_2);
		IntEnable(INT_GPIOL_TM4C129);


  GPIOPinConfigure(0x00000001);
						//TX
	GPIOPinConfigure(0x00000401);

  GPIOPinTypeUART(GPIO_PORTA_BASE,GPIO_PIN_0|GPIO_PIN_1);
		
	UARTConfigSetExpClk(UART0_BASE, SystemClock, 115200,
                        (UART_CONFIG_WLEN_8 | UART_CONFIG_STOP_ONE | UART_CONFIG_PAR_NONE));
	UARTStdioConfig(0, 115200, SystemClock);
		// UART0, Clock de 120MHz, Baud Rate 115200, 8-N-1 (8 bits, sem paridade, 1 stop bit)
  UARTConfigSetExpClk(UART0_BASE, SystemClock, 115200,
                        (UART_CONFIG_WLEN_8 | UART_CONFIG_STOP_ONE | UART_CONFIG_PAR_NONE));

  //config Timer0
  TimerConfigure(TIMER0_BASE, TIMER_CFG_PERIODIC);
  TimerLoadSet(TIMER0_BASE, TIMER_A, (SystemClock / 10000) - 1);
  TimerControlTrigger(TIMER0_BASE, TIMER_A, true);

  //config timer1
  TimerConfigure(TIMER1_BASE, TIMER_CFG_PERIODIC);
  TimerLoadSet(TIMER1_BASE, TIMER_A, (SystemClock / 10000) - 1);
  TimerIntEnable(TIMER1_BASE, TIMER_TIMA_TIMEOUT);
  IntEnable(INT_TIMER1A_TM4C129);
    //config ADC
  GPIOPinTypeADC(GPIO_PORTK_BASE, GPIO_PIN_0);
			
	GPIOPinTypeADC(GPIO_PORTE_BASE, GPIO_PIN_3|GPIO_PIN_4);						
    // Configure sequencer 0 to be triggered by a hardware timer
		//ADC0 nas portas PK0,AN16

  ADCSequenceConfigure(ADC0_BASE, 0, ADC_TRIGGER_TIMER, 0);	
  ADCSequenceStepConfigure(ADC0_BASE,0,0,ADC_CTL_CH16);
  ADCSequenceStepConfigure(ADC0_BASE,0,1,ADC_CTL_CH0);
  ADCSequenceStepConfigure(ADC0_BASE,0,2,ADC_CTL_CH9|ADC_CTL_IE | ADC_CTL_END);
  ADCSequenceEnable(ADC0_BASE,0);
  ADCIntClear(ADC0_BASE,0);

  //1ms para o threadX
  SysTickPeriodSet(SystemClock/ 1000);
  SysTickEnable();
  SysTickIntEnable();

  IntEnable(INT_ADC0SS0_TM4C129);

  TimerEnable(TIMER0_BASE, TIMER_A);
  //TimerEnable(TIMER1_BASE, TIMER_A);
}
//filtro
arm_fir_instance_f32 S_FIR;
float32_t fir_state[NUM_TAPS + BLOCK_SIZE - 1];

//fazer para os outros
static const float32_t fir_coeffs[NUM_FILTERS][NUM_FREQ][NUM_TAPS] = {
    {
        { -0.0007638622, -0.0008415465, -0.0009513712, -0.0010920778, -0.0012550847, -0.0014240141, -0.0015747067, -0.0016757545, -0.0016895484, -0.0015738119, -0.0012835581, -0.0007733856, 0.0000000000,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 -0.0008415465, -0.0007638622 },
        { -0.0004672613, -0.0002605991, 0.0000000000, 0.0003381804, 0.0007677464, 0.0012797449, 0.0018322331, 0.0023456206, 0.0027057687, 0.0027758505, 0.0024164857, 0.0015120926, -0.0000000000,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 -0.0002605991, -0.0004672613 },
        { 0.0007567956, 0.0004961814, -0.0000000000, -0.0006438963, -0.0012434738, -0.0015059249, -0.0011335072, 0.0000000000, 0.0016739182, 0.0032664496, 0.0039138401, 0.0028790282, -0.0000000000,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 0.0004961814, 0.0007567956 },
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        { 0.0004674825, -0.0002607225, 0.0000000000, 0.0003383405, -0.0007681098, 0.0012803508, -0.0018331005, 0.0023467310, -0.0027070496, 0.0027771646, -0.0024176297, 0.0015128084, -0.0000000000,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 -0.0002607225, 0.0004674825 },
    },
    {
        { 0.0007562777, 0.0008331906, 0.0009419248, 0.0010812343, 0.0012426227, 0.0014098747, 0.0015590710, 0.0016591155, 0.0016727725, 0.0015581851, 0.0012708133, 0.0007657065, -0.0000000000,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 0.0008331906, 0.0007562777 },
        { 0.0004674825, 0.0002607225, -0.0000000000, -0.0003383405, -0.0007681098, -0.0012803508, -0.0018331005, -0.0023467310, -0.0027070496, -0.0027771646, -0.0024176297, -0.0015128084, -0.0000000000,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 0.0002607225, 0.0004674825 },
        { -0.0007574498, -0.0004966103, -0.0000000000, 0.0006444529, 0.0012445487, 0.0015072266, 0.0011344871, -0.0000000000, -0.0016753652, -0.0032692732, -0.0039172233, -0.0028815169, -0.0000000000,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 -0.0004966103, -0.0007574498 },
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        { -0.0004672613, 0.0002605991, -0.0000000000, -0.0003381804, 0.0007677464, -0.0012797449, 0.0018322331, -0.0023456206, 0.0027057687, -0.0027758505, 0.0024164857, -0.0015120926, -0.0000000000,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 0.0002605991, -0.0004672613 },
    },
    {
        { -0.0004693391, -0.0002617580, -0.0000000000, 0.0003396842, 0.0007711604, 0.0012854357, 0.0018403807, 0.0023560511, 0.0027178007, 0.0027881942, 0.0024272313, 0.0015188166, -0.0000000001,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 -0.0002617580, -0.0004693391 },
        { 0.0012385487, 0.0016040757, 0.0019067353, 0.0020816145, 0.0020350314, 0.0016775419, 0.0009752646, -0.0000000000, -0.0010463896, -0.0018540093, -0.0020811989, -0.0014741539, 0.0000000000,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 0.0016040757, 0.0012385487 },
        { -0.0004721163, -0.0013617185, -0.0019028368, -0.0017671067, -0.0007757235, 0.0008801328, 0.0025480554, 0.0033516753, 0.0027338825, 0.0009727175, -0.0007933219, -0.0012514263, 0.0000000000,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 -0.0013617185, -0.0004721163 },
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        { 0.0012385487, -0.0016040757, 0.0019067353, -0.0020816145, 0.0020350314, -0.0016775419, 0.0009752646, -0.0000000000, -0.0010463896, 0.0018540093, -0.0020811989, 0.0014741539, 0.0000000000,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 -0.0016040757, 0.0012385487 },
    },
};


//thread
TX_THREAD           thread_filter;             // O "Objeto" da thread
TX_THREAD           thread_UI;
uint8_t             stack_filter[1024];
uint8_t             stack_UI[1024];
void thread_filter_entry(ULONG thread_input);
void thread_UIManager_entry(ULONG thread_input);

float32_t bufferA[BLOCK_SIZE];
float32_t bufferB[BLOCK_SIZE];

volatile int bufferAtivo = 0;      // 0 = A, 1 = B
volatile int posISR = 0;           // posição da ISR dentro do bloco
volatile bool bufferPronto = false; // thread DSP avisa ISR
//TX_SEMAPHORE semaforo_dados;
TX_QUEUE queue_amostras;
uint32_t queue_storage[NUM_AMOSTRAS];

void tx_application_define(void *first_unused_memory){
  tx_queue_create(&queue_amostras,
                "fila_adc",
                TX_1_ULONG,           // tamanho do item = 1 ULONG (4 bytes)
                queue_storage,
                sizeof(queue_storage));
  //tx_semaphore_create(&semaforo_dados, "SemDados", 0);
  tx_thread_create(&thread_filter,"ThreadFiltro",thread_filter_entry,0,stack_filter,sizeof(stack_filter),
  1,1,TX_NO_TIME_SLICE,TX_AUTO_START);
  tx_thread_create(&thread_UI,"ThreadUI",thread_UIManager_entry,0,stack_UI,sizeof(stack_UI),
  2,2,TX_NO_TIME_SLICE,TX_AUTO_START);
}
volatile bool first_run=true;

void thread_filter_entry(ULONG thread_input){
    uint32_t new_data;
    float32_t bufferProcessamento[BLOCK_SIZE];
    float32_t bufferProcessado[BLOCK_SIZE];
    ADCIntEnable(ADC0_BASE, 0);	
    arm_fir_init_f32(&S_FIR, NUM_TAPS, (float32_t*)fir_coeffs[filter][freq], fir_state, BLOCK_SIZE);

    while(1){  
      if (update_filter_needed) {
          if (filter > 2) filter = 0;
          if (freq > 9) freq = 9;

          arm_fir_init_f32(&S_FIR, NUM_TAPS, 
                          (float32_t*)fir_coeffs[filter][freq], 
                          fir_state, BLOCK_SIZE);
          
          //UARTprintf("Filtro Atualizado: Tipo %d, Freq %d Hz\n", filter, freqs[freq]);
          update_filter_needed = false; 
      }


    
        for (int i = 0; i < BLOCK_SIZE; i++) {
          tx_queue_receive(&queue_amostras, &new_data, TX_WAIT_FOREVER);
          bufferProcessamento[i] = (float32_t)new_data - 2048.0f;  
					//UARTprintf("Entrada:%d \n ", new_data);
        }

    arm_fir_f32(&S_FIR, bufferProcessamento, bufferProcessado, BLOCK_SIZE);
      if (bufferAtivo == 0) {
            for (int i=0; i < BLOCK_SIZE; i++){
                float32_t sinal_adc = bufferProcessado[i]+ 2048.0f;

                if (sinal_adc < 0) sinal_adc = 0;
                if (sinal_adc > 4095) sinal_adc = 4095;

                float32_t sinal_pwm = (sinal_adc * 600.0f) / 4096.0f;
                bufferB[i] = sinal_pwm;
							//UARTprintf("Saida:%d  \n", (int16_t)sinal_pwm);
            }
						//UARTprintf("Usando bufferB\n");
        } else {
            // ISR está tocando B → escrevo no A
            for (int i=0; i < BLOCK_SIZE; i++){
                float32_t sinal_adc = bufferProcessado[i]+ 2048.0f;

                if (sinal_adc < 0) sinal_adc = 0;
                if (sinal_adc > 4095) sinal_adc = 4095;

                float32_t sinal_pwm = (sinal_adc * 600.0f) / 4096.0f;
                bufferA[i] = sinal_pwm;
							//UARTprintf("Saida:%d  \n", (int16_t)sinal_pwm);
            }
        }
				//UARTprintf("UsandoBufferB\n");

        // Marca como pronto → ISR troca quando terminar o bloco atual
      bufferPronto = true;
				if(first_run){
					TimerEnable(TIMER1_BASE,TIMER_A);
					first_run=false;
				}
  }
}

void thread_UIManager_entry(ULONG thread_input){
  DisplaySetup();
  DesenharTelaPrincipal();
  while(1){
    IHM_Loop();
    tx_thread_sleep(500);
}
}

extern volatile ULONG _tx_timer_system_clock;

//


//interrupção
void ADC0SS0_Handler(void)
{
  ADCIntClear(ADC0_BASE, 0);
  ADCSequenceDataGet(ADC0_BASE, 0, (uint32_t*)adcSamples);
  tx_queue_send(&queue_amostras, &adcSamples[0], TX_NO_WAIT);
  
}
volatile ULONG tempo_joystick=0;
void GPIOC_Handler(void){
	 uint32_t status=GPIOIntStatus(GPIO_PORTC_BASE, true);
	 GPIOIntClear(GPIO_PORTC_BASE, status);
   ULONG tempo_atual=tx_time_get();
   if(tempo_atual-tempo_joystick>DEBOUNCE){
      button_joystick=true;
      tempo_joystick=tempo_atual;
   }

	 
} 
volatile ULONG ultimo_tempo1=0;
volatile ULONG ultimo_tempo2=0;
void GPIOL_Handler(void){
	 uint32_t status=GPIOIntStatus(GPIO_PORTL_BASE, true);
	 GPIOIntClear(GPIO_PORTL_BASE, status);
   if(status & GPIO_PIN_1){
    ULONG tempo_atual1 = tx_time_get();
    if(tempo_atual1-ultimo_tempo1>DEBOUNCE){
      if(modo_filter==2){
        modo_filter=0;
      }
      else
        modo_filter++;
      ultimo_tempo1=tempo_atual1;
      button_1=true;
    }
  }

   else if(status & GPIO_PIN_2){
    ULONG tempo_atual2 = tx_time_get();
    if(tempo_atual2-ultimo_tempo2>DEBOUNCE){
      button_2=true;
      ultimo_tempo2=tempo_atual2;
    }
   }
} 

void TIMER1A_Handler(void) {
    TimerIntClear(TIMER1_BASE, TIMER_TIMA_TIMEOUT);

    float32_t valor;

    if (bufferAtivo == 0){
			valor = bufferA[posISR];
		}
    else{
			valor = bufferB[posISR];
		}
    uint32_t pwm = (uint32_t) valor;
    PWMPulseWidthSet(PWM0_BASE, PWM_OUT_2, pwm);

    posISR++;
		//UARTprintf("Buffer:%d , pos:%d\n ",bufferAtivo,posISR);
    // Chegou no fim do bloco?
    if (posISR == BLOCK_SIZE) {
        posISR = 0;
        // Só troca se a thread já tiver produzido o outro bloco
        if (bufferPronto) {
            bufferAtivo ^= 1;   // Alterna A→B ou B→A
            bufferPronto = false;
        }
			}
}

int main(void){
  init_hw();
  _tx_timer_system_clock = SystemClock;
	IntPrioritySet(FAULT_PENDSV, 0xFF);
  IntPrioritySet(FAULT_SYSTICK, 0xFF);
/*     while(1){
      if(leitura){
        leitura=false;
        UARTprintf("%d\n",adcSamples[0]);
      }
    } */
  tx_kernel_enter();
}
    
